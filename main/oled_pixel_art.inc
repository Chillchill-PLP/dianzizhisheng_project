/* 历史 OLED 点阵素材片段，当前 main.c 不 include 本文件，因此不参与当前显示。
 * 此文件只包含字节初始化项，设计为放在某个 uint8 数组的大括号内引用，
 * 不是独立 C 编译单元；显示尺寸、点阵排列和解码应以原引用程序为准。
 * 当前 ST7789 校标使用 main.c 的 s_logo_bitmap / s_logo_palette，修改这里不会改变它。
 * 保留原始字节，避免逐项注释破坏素材阅读和维护。
 */
    0x00, 0x00, 0x00, 0x00, 0x00, 0x00, 0x00, 0x00, 0x00, 0x00, 0x00, 0x00, 0x00, 0x00, 0x00, 0x00,
    0x00, 0x00, 0x00, 0x00, 0x00, 0x00, 0x00, 0x00, 0x00, 0x00, 0x00, 0x00, 0x00, 0x00, 0x00, 0x00,
    0x00, 0x00, 0x00, 0x00, 0x00, 0x00, 0x00, 0x00, 0x00, 0x00, 0x00, 0x00, 0x00, 0x00, 0x00, 0x00,
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    0x00, 0x00, 0x00, 0x00, 0x00, 0x00, 0x00, 0x00, 0x00, 0x00, 0x00, 0x00, 0x00, 0x00, 0x00, 0x00,
